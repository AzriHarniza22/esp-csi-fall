## examples/esp-radar/wifi_sensing_demo/esp-radar/test_apps/main/Kconfig.projbuild
```kconfig
menu "ESP Radar test app"

    config ESP_RADAR_TEST_MULTI_PEER
        bool "Enable multi-peer mode (use esp_radar_new_peer + wifi_radar_cb_ex)"
        default n
        help
            If enabled, the test app will create additional peers by MAC address and use
            wifi_radar_cb_ex to report radar info per peer.
            If disabled, the app runs in legacy single-peer mode using wifi_radar_cb.

endmenu
```

## examples/esp-radar/wifi_sensing_demo/esp_wifi_sensing/Kconfig
```kconfig
menu "ESP Wi-Fi sensing"

config ESP_WIFI_SENSING_PING_FREQUENCY_HZ
    int "Router ping frequency used to trigger CSI (Hz)"
    range 1 1000
    default 100
    help
        Frequency (Hz) of ICMP ping packets to the router gateway used as CSI trigger.
        Higher values generate more traffic and CPU load. Typical values: 10~200.

config ESP_WIFI_SENSING_CONFIRM_COUNT
    int "Consecutive samples to confirm level"
    range 1 15
    default 2
    help
        Continuous N times HIGH is considered ACTIVE; continuous N times LOW is considered INACTIVE.

config ESP_WIFI_SENSING_ACTIVE_FILTER_MS
    int "ACTIVE hold/filter window (ms)"
    range 0 10000
    default 300
    help
        When already ACTIVE, LOW samples received before this window expires will be ignored.
        This helps reduce rapid STOP/START flapping. Set 0 to disable.

config ESP_WIFI_SENSING_DEFAULT_SENSITIVITY
    int "Default motion detection sensitivity (x1000)"
    range 1 1000
    default 500
    help
        Default motion detection sensitivity for newly created channels, scaled by 1000.
        The actual float value is CONFIG_ESP_WIFI_SENSING_DEFAULT_SENSITIVITY / 1000.0.
        Larger values make the detector more sensitive.

config ESP_WIFI_SENSING_DEFAULT_ACTIVE_JITTER_MIN
    int "Default active jitter minimum (x1000)"
    range 0 1000
    default 10
    help
        Default minimum jitter required before entering ACTIVE, scaled by 1000.
        The actual float value is CONFIG_ESP_WIFI_SENSING_DEFAULT_ACTIVE_JITTER_MIN / 1000.0.
        Set 0 to disable this guard.

config ESP_WIFI_SENSING_DEFAULT_PRESENCE_SENSITIVITY
    int "Default presence detection sensitivity (x1000)"
    range 0 1000
    default 250
    help
        Per-channel default for presence detection sensitivity, scaled by 1000 (0.0 .. 1.0).
        Larger values mean more sensitive presence detection. Default is 0.25.

endmenu
```

## examples/esp-radar/wifi_sensing_demo/main/Kconfig.projbuild
```kconfig
menu "Wi-Fi sensing demo"

choice ESP_WIFI_SENSING_DEMO_LED_TYPE
    prompt "LED type"
    default ESP_WIFI_SENSING_DEMO_LED_TYPE_GPIO
    help
        Choose between a single GPIO LED and a single WS2812 LED.

    config ESP_WIFI_SENSING_DEMO_LED_TYPE_GPIO
        bool "GPIO LED"

    config ESP_WIFI_SENSING_DEMO_LED_TYPE_WS2812
        bool "WS2812 LED"
endchoice

config ESP_WIFI_SENSING_DEMO_LED_GPIO
    int "LED GPIO"
    default 2
    help
        GPIO used for the LED output. For WS2812 this is the data pin.

if ESP_WIFI_SENSING_DEMO_LED_TYPE_WS2812

choice ESP_WIFI_SENSING_DEMO_WS2812_BACKEND
    prompt "WS2812 backend"
    default ESP_WIFI_SENSING_DEMO_WS2812_BACKEND_RMT
    help
        Select the peripheral used to drive the WS2812 LED.

    config ESP_WIFI_SENSING_DEMO_WS2812_BACKEND_RMT
        bool "RMT backend"

    config ESP_WIFI_SENSING_DEMO_WS2812_BACKEND_SPI
        bool "SPI backend"
endchoice

endif

config ESP_WIFI_SENSING_WEB_SERIAL_ENABLE
    bool "Enable Web Serial monitor output"
    default y
    help
        Stream sensing diagnostics to the host over the standard serial console.
        The browser Web Serial page can connect to whichever serial port is
        exposed by the current console configuration.

config ESP_WIFI_SENSING_WEB_SERIAL_STREAM_PERIOD_MS
    int "Web Serial stream period (ms)"
    default 50
    range 20 1000
    depends on ESP_WIFI_SENSING_WEB_SERIAL_ENABLE
    help
        Period used to push one diagnostic snapshot per channel to the Web Serial UI.

menu "AP HT traffic stimulus"

config ESP_WIFI_SENSING_HT_STIMULUS_ENABLE
    bool "Enable AP HT-rate traffic stimulus"
    default y
    help
        This AP only yields usable CSI from HT (11n) frames, so a plain ping
        leaves the channel flat. The official esp-csi csi_recv_router example
        captures router CSI with LLTF sub-carriers alone, but that does not work
        here: LLTF-only still produced 0/776 non-zero samples while the AP was
        answering pings at 80 Hz.

        When enabled, the firmware keeps a small HTTP transfer running through
        the AP so the AP continuously transmits large HT frames, which are the
        frames this chip can actually measure.

        This runs entirely on the ESP with no laptop or extra peer involved, but
        it needs the AP to have internet access, and the bulk downlink traffic
        inflates latency for other clients on the same link.

        Measured with the stimulus off, the graph froze for up to 6 s at a time
        (35-53% of samples held one value, only 5.3 detection windows per 45 s).
        With a 200 KB burst every 100 ms it froze 20% of the time and produced
        18.4 windows per 45 s, so it stays enabled by default. SET_STIMULUS off
        on the web UI turns it off at runtime.

config ESP_WIFI_SENSING_HT_STIMULUS_URL
    string "HT stimulus URL"
    default "http://speed.cloudflare.com/__down?bytes=2000000"
    depends on ESP_WIFI_SENSING_HT_STIMULUS_ENABLE
    help
        Plain HTTP endpoint fetched to provoke AP HT transmissions. The "bytes"
        query parameter of the default endpoint controls the transfer size.

config ESP_WIFI_SENSING_HT_STIMULUS_BURST
    int "Bytes fetched per burst"
    default 200000
    range 100000 20000000
    depends on ESP_WIFI_SENSING_HT_STIMULUS_ENABLE
    help
        Number of bytes to read per burst before pausing. Larger values keep the
        AP busy longer; smaller values leave more airtime for other traffic.

        What the radar needs is snapshot count, not byte count. Measured on an
        11n AP at -60 dBm: 200 KB/burst produced 6x more HT frames and 3.5x more
        detection windows than no stimulus, while 1-2 MB bursts saturated the
        link and cut the window flush rate back down. Keep this small.

config ESP_WIFI_SENSING_HT_STIMULUS_PAUSE_MS
    int "Pause between bursts (ms)"
    default 100
    range 0 5000
    depends on ESP_WIFI_SENSING_HT_STIMULUS_ENABLE
    help
        Idle gap between bursts. A short gap keeps the AP saturated without
        starving other traffic on the link.

        100 ms with a 200 KB burst measured best: 10 bursts and 0 window clears
        per 45 s. A 0 ms pause starves the link and produced 16 window clears and
        63% frozen samples.

config ESP_WIFI_SENSING_HT_STIMULUS_RETRY_MS
    int "Retry delay after a failed burst (ms)"
    default 2000
    range 200 30000
    depends on ESP_WIFI_SENSING_HT_STIMULUS_ENABLE
    help
        Delay applied when the endpoint is unreachable, for example when the AP
        has no internet access, so the task does not spin.

endmenu

menu "ESP Wi-Fi sensing MQTT telemetry"

config ESP_WIFI_SENSING_MQTT_ENABLE
    bool "Publish radar telemetry to an MQTT broker"
    default n
    help
        Publishes the same peer samples the web serial monitor streams, to an
        MQTT broker over TLS, so a dashboard can read them from any phone
        without the ESP32 being attached to a laptop.

        This is one-way only. It does not produce the CSI the radar measures:
        OFDM frames have to be on the air for that, which is what the HT
        stimulus is for.

config ESP_WIFI_SENSING_MQTT_BROKER
    string "Broker host"
    default "z4e56ccf.ala.asia-southeast1.emqxsl.com"
    depends on ESP_WIFI_SENSING_MQTT_ENABLE
    help
        Hostname of the MQTT broker. EMQX Cloud Serverless only accepts TLS,
        so this must resolve and present a certificate the firmware trusts.

config ESP_WIFI_SENSING_MQTT_PORT
    int "Broker TLS port"
    default 8883
    range 1 65535
    depends on ESP_WIFI_SENSING_MQTT_ENABLE
    help
        MQTT over TLS. EMQX Cloud Serverless exposes 8883 for MQTT and 8084 for
        MQTT over WebSocket; plain 1883 is not accepted.

config ESP_WIFI_SENSING_MQTT_USERNAME
    string "Broker username (first boot fallback)"
    default "esp32"
    depends on ESP_WIFI_SENSING_MQTT_ENABLE
    help
        Only used when nothing is stored in NVS yet. Once HMSCMD MQTT_CONFIG
        runs, the NVS copy wins and this value is ignored. Same for the
        password, broker, port and topic prefix.

config ESP_WIFI_SENSING_MQTT_PASSWORD
    string "Broker password (first boot fallback)"
    default "esp32"
    depends on ESP_WIFI_SENSING_MQTT_ENABLE

config ESP_WIFI_SENSING_MQTT_TOPIC_PREFIX
    string "Topic prefix"
    default "radar/esp32"
    depends on ESP_WIFI_SENSING_MQTT_ENABLE
    help
        Peer samples are published to <prefix>/peer/<name>, a retained status
        message to <prefix>/status, remote commands are read from <prefix>/cmd,
        and command results come back on <prefix>/ack. Keep the prefix
        unguessable: anyone who knows it can read the telemetry and send
        commands to the device.

config ESP_WIFI_SENSING_MQTT_CLIENT_ID
    string "MQTT client id"
    default "radar-esp32"
    depends on ESP_WIFI_SENSING_MQTT_ENABLE
    help
        Must be stable across reboots. The device suffix is appended from the
        STA MAC at runtime, so two units on the same build never collide.

config ESP_WIFI_SENSING_MQTT_KEEPALIVE_S
    int "MQTT keepalive (s)"
    default 45
    range 10 3600
    depends on ESP_WIFI_SENSING_MQTT_ENABLE
    help
        The broker declares the device offline after roughly 1.5x this value,
        so this is how fast a dashboard notices a dead unit. 45 s detects death
        within about 70 s. Espressif warns that values below 30 s increase the
        disconnect rate on marginal links, which matters here because the AP
        already drops this station from time to time.

config ESP_WIFI_SENSING_MQTT_WILL_DELAY_S
    int "LWT delay before the broker publishes it (s)"
    default 5
    range 0 300
    depends on ESP_WIFI_SENSING_MQTT_ENABLE
    help
        If the device reconnects within this window the will message is
        discarded, so a brief Wi-Fi drop does not flash "offline" on the
        dashboard. Too long delays the notice that the unit really is gone.

config ESP_WIFI_SENSING_MQTT_SESSION_EXPIRY_S
    int "Session expiry interval (s)"
    default 300
    range 0 86400
    depends on ESP_WIFI_SENSING_MQTT_ENABLE
    help
        How long the broker keeps this session, and therefore queued commands,
        while the device is offline. Commands are QoS 1, so without a session
        expiry interval the broker discards them and a command sent during an
        outage never arrives.

config ESP_WIFI_SENSING_MQTT_MESSAGE_EXPIRY_S
    int "Telemetry message expiry (s)"
    default 60
    range 5 3600
    depends on ESP_WIFI_SENSING_MQTT_ENABLE
    help
        Subscribers must discard radar samples older than this. Without it a
        dashboard opened after a long outage would draw a curve made of
        minutes-old values and read it as a live measurement.

config ESP_WIFI_SENSING_MQTT_PUBLISH_MS
    int "Publish interval (ms)"
    default 1000
    range 200 60000
    depends on ESP_WIFI_SENSING_MQTT_ENABLE
    help
        How often every peer sample is published. The radar updates on its own
        schedule, so a shorter interval only repeats values. The EMQX free tier
        allows 1 GB of traffic per month; at 1 Hz three peers stay well inside
        that, while publishing every sample pushed the link hard enough to be
        worth rate limiting.

config ESP_WIFI_SENSING_MQTT_ALLOW_RECONFIG
    bool "Accept WIFI_CONFIG_HEX over MQTT"
    default y
    depends on ESP_WIFI_SENSING_MQTT_ENABLE
    help
        The dashboard and the device share one broker credential, so anybody
        who can open the dashboard can also send commands to the device. This
        option is the only thing stopping them from repointing it at a
        different AP. Turn it off before showing the device to anyone who is
        not the owner.

endmenu

endmenu

config ESP_WIFI_SENSING_UPLINK_WATCHDOG_ENABLE
    bool "Restart the unit when the internet path stops working"
    default y
    depends on ESP_WIFI_SENSING_MQTT_ENABLE
    help
        The Wi-Fi stack keeps reporting a healthy association and a valid IP
        while the route to the broker is dead. On this board that was measured
        after about 77 minutes of uptime, and the normal reconnect loop never
        recovered from it while a power cycle always did. When enabled, a
        sustained outage ends in a restart.

config ESP_WIFI_SENSING_UPLINK_PROBE_PERIOD_MS
    int "Uplink probe interval (ms)"
    default 30000
    range 5000 600000
    depends on ESP_WIFI_SENSING_UPLINK_WATCHDOG_ENABLE
    help
        How often the broker is probed with a real TCP connection. Thirty
        seconds keeps the traffic negligible.

config ESP_WIFI_SENSING_UPLINK_PROBE_TIMEOUT_S
    int "Probe connect timeout (s)"
    default 4
    range 1 30
    depends on ESP_WIFI_SENSING_UPLINK_WATCHDOG_ENABLE
    help
        Applied to both directions of the probe socket so a black hole costs
        this much and no more.

config ESP_WIFI_SENSING_UPLINK_FAIL_AFTER_S
    int "Act after the path has been down this long (s)"
    default 90
    range 60 3600
    depends on ESP_WIFI_SENSING_UPLINK_WATCHDOG_ENABLE
    help
        Long enough to ride out a router or ISP hiccup, short enough that a
        dashboard is not blind for long. The access point this unit runs on
        drops its association while still visible in a scan, and that was
        measured to take the full old threshold to notice: five minutes of no
        telemetry for a fault that re-associating fixes in seconds.

config ESP_WIFI_SENSING_UPLINK_HEALTHY_FOR_S
    int "Refund a restart after the path holds this long (s)"
    default 600
    range 60 3600
    depends on ESP_WIFI_SENSING_UPLINK_WATCHDOG_ENABLE
    help
        Restarts are budgeted. A healthy stretch this long proves the unit came
        back because of the restart, so the budget is restored and a later
        outage gets the same help again.

config ESP_WIFI_SENSING_UPLINK_MAX_REBOOTS
    int "Restarts allowed before giving up"
    default 3
    range 1 20
    depends on ESP_WIFI_SENSING_UPLINK_WATCHDOG_ENABLE
    help
        Without a cap, an access point that is simply gone would put the unit
        into a restart loop. Once the budget is spent the watchdog stops
        restarting and the unit just keeps retrying, which is no worse than
        having no watchdog at all.
```
